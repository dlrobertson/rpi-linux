## Documentation/devicetree/bindings/iio/accel/bma400.txt
```
* Bosch BMA400 triaxial acceleration sensor

https://ae-bst.resource.bosch.com/media/_tech/media/datasheets/BST-BMA400-DS000.pdf

Required properties:

  - compatible : should be "bosch,bma400"
  - reg : the I2C address of the sensor

Example:

bma400@14 {
	compatible = "bosch,bma400";
	reg = <0x14>;
};
```

## Documentation/devicetree/bindings/iio/accel/bosch,bma400.yaml
```yaml
# SPDX-License-Identifier: GPL-2.0
%YAML 1.2
---
$id: http://devicetree.org/schemas/iio/accel/bosch,bma400.yaml#
$schema: http://devicetree.org/meta-schemas/core.yaml#

title: Bosch BMA400 triaxial acceleration sensor

maintainers:
  - Dan Robertson <dan@dlrobertson.com>

description: |
  Acceleration and temerature iio sensors with an i2c interface

  Specifications about the sensor can be found at:
    https://ae-bst.resource.bosch.com/media/_tech/media/datasheets/BST-BMA400-DS000.pdf

properties:
  compatible:
    enum:
      - bosch,bma400

  reg:
    maxItems: 1

required:
  - compatible
  - reg

examples:
  - |
    i2c {
      #address-cells = <1>;
      #size-cells = <0>;
      accelerometer@14 {
        compatible = "bosch,bma400";
        reg = <0x14>;
      };
    };
```
